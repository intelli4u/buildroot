## fs/Config.in
```kconfig
menu "Filesystem images"

source "fs/cramfs/Config.in"
source "fs/squashfs/Config.in"

endmenu
```

## fs/squashfs/Config.in
```kconfig
config BR2_TARGET_ROOTFS_SQUASHFS
	bool "squashfs root filesystem"
	help
	  Build a squashfs root filesystem

if BR2_TARGET_ROOTFS_SQUASHFS

config BR2_TARGET_ROOTFS_SQUASHFS_ARGS
	string "Squashfs command line args"
	help
	  Set extra squashfs command line arguements for customization.

choice
	prompt "Compression algorithm"
	default BR2_TARGET_ROOTFS_SQUASHFS4_GZIP
	help
	  Select the squashfs compression algorithm to use when
	  generating the filesystem.

config BR2_TARGET_ROOTFS_SQUASHFS4_GZIP
	bool "gzip"

config BR2_TARGET_ROOTFS_SQUASHFS4_LZ4
	bool "lz4"

config BR2_TARGET_ROOTFS_SQUASHFS4_LZMA
	bool "lzma"

config BR2_TARGET_ROOTFS_SQUASHFS4_LZO
	bool "lzo"

config BR2_TARGET_ROOTFS_SQUASHFS4_XZ
	bool "xz"

endchoice
endif
```

## package/Config.in
```kconfig
menu "Target packages"
	source "package/skeleton/Config.in"
	source "package/skeleton-custom/Config.in"
	source "package/luainterpreter/Config.in"

endmenu
```
